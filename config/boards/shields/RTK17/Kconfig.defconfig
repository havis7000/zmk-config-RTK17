## config/boards/shields/RTK17/Kconfig.defconfig
```kconfig
# Copyright (c) 2021 The ZMK Contributors
# SPDX-License-Identifier: MIT

if SHIELD_RTK17

config ZMK_KEYBOARD_NAME
    default "RTK17"

endif
```
